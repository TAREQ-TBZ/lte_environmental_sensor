## CMakeLists.txt
```
#
# Copyright (c) 2024 Tareq Mhisen
#
# SPDX-License-Identifier: Apache-2.0
#

cmake_minimum_required(VERSION 3.20.0)

find_package(Zephyr REQUIRED HINTS $ENV{ZEPHYR_BASE})
project(app LANGUAGES C)

target_sources(app PRIVATE
    src/main.c
    src/modem_svc.c
    src/coap_client.c
    #src/udp_client.c
)
```

## Kconfig
```
#
# Copyright (c) 2024 Tareq Mhisen
#
# SPDX-License-Identifier: Apache-2.0
#

menu "CoAP Configuration"

config COAP_SERVER_HOSTNAME
	string "CoAP server hostname"

config COAP_SERVER_PORT
	int "CoAP server port"
	default 5683

config COAP_TX_RESOURCE
	string "CoAP resource - this is the TX channel of the board"
	default "large-update"

config COAP_RX_RESOURCE
	string "CoAP resource - this is the RX channel of the board"
	default "validate"	
endmenu

menu "Zephyr Kernel"
source "Kconfig.zephyr"
endmenu
```

## prj.conf
```kconfig
#
# Copyright (c) 2024 Tareq Mhisen
#
# SPDX-License-Identifier: Apache-2.0
#

#
# LOGGING
#
CONFIG_LOG=y
# Disable the following lines to save power, only enable them for debugging
CONFIG_SERIAL=n
CONFIG_AT_HOST_LIBRARY=n
CONFIG_UART_INTERRUPT_DRIVEN=n

#
# Network
#
CONFIG_NETWORKING=y
CONFIG_NET_SOCKETS=y
CONFIG_NET_SOCKETS_POSIX_NAMES=y
CONFIG_NET_SOCKETS_OFFLOAD=y
# Disable the Zephyr native IP stack to be able to offload all socket calls to the IP stack running on the modem firmware.
CONFIG_NET_NATIVE=n 

#
# Memory
#
CONFIG_HEAP_MEM_POOL_SIZE=4096
CONFIG_MAIN_STACK_SIZE=4096

#
# Modem library
#
CONFIG_NRF_MODEM_LIB=y

#
# LTE link control
#
CONFIG_LTE_LINK_CONTROL=y
CONFIG_LTE_MODE_PREFERENCE_NBIOT=y


# Configure PSM mode
CONFIG_LTE_LC_PSM_MODULE=y
CONFIG_LTE_PSM_REQ=y 

# Request periodic TAU of 12 hours
CONFIG_LTE_PSM_REQ_RPTAU="00101100"

# Set Requested Active Time (RAT) to 10 seconds.
CONFIG_LTE_PSM_REQ_RAT="00000101"

# Enable Sleep event's from modem for indicate sleep
CONFIG_LTE_LC_MODEM_SLEEP_MODULE=y
CONFIG_LTE_LC_MODEM_SLEEP_NOTIFICATIONS=y

#
# CoAP
#
CONFIG_COAP=y
CONFIG_COAP_SERVER_HOSTNAME="coap.thingsboard.cloud"
```

## src/main.c
```c
/*
 * Copyright (c) 2024 Tareq Mhisen
 *
 * SPDX-License-Identifier: Apache-2.0
 */

#include "coap_client.h"
#include "modem_svc.h"
#include <zephyr/kernel.h>
#include <zephyr/logging/log.h>

LOG_MODULE_REGISTER(main, LOG_LEVEL_INF);

static struct k_work_delayable telemetry_work;

static int temperature;
static int humidity = 20;

static void telemetry_work_handler(struct k_work *work) {
  if (temperature < 40) {
    temperature++;
  } else {
    temperature = 0;
  }

  if (humidity < 60) {
    humidity++;
  } else {
    humidity = 20;
  }

  coap_client_send_env_data(temperature, humidity);

  k_work_reschedule(&telemetry_work, K_SECONDS(30));
}

int main(void) {
  int ret;

  LOG_INF("Starting up .. .. ..");
  k_work_init_delayable(&telemetry_work, telemetry_work_handler);

  ret = modem_svc_init();
  if (ret != 0) {
    LOG_ERR("Failed to initialize the modem service!");
  }

  ret = coap_client_init();
  if (ret != 0) {
    LOG_ERR("Failed to initialize the coap client!");
  }

  k_work_schedule(&telemetry_work, K_SECONDS(5));

  return 0;
}
```

## src/coap_client.c
```c
/*
 * Copyright (c) 2024 Tareq Mhisen
 * Copyright (c) 2020 Nordic Semiconductor ASA
 *
 * SPDX-License-Identifier: Apache-2.0
 * SPDX-License-Identifier: LicenseRef-Nordic-5-Clause
 */

#include "coap_client.h"
#include <stdio.h>
#include <zephyr/kernel.h>
#include <zephyr/logging/log.h>
#include <zephyr/net/coap.h>
#include <zephyr/net/socket.h>
#include <zephyr/random/random.h>

LOG_MODULE_REGISTER(coap_client, LOG_LEVEL_INF);

#define APP_COAP_VERSION 1
#define APP_COAP_MAX_MSG_LEN 1280
#define DEVICE_TOKEN "qqvdy68yywn6x6q5pfw6"
#define COAP_PATH "api/v1/" DEVICE_TOKEN "/telemetry"

static uint8_t coap_buf[APP_COAP_MAX_MSG_LEN];
static uint16_t next_token;
static int sock;
static struct sockaddr_storage server;

static int configure_socket_timeout(int sock, int timeout_sec,
                                    int timeout_usec) {
  struct timeval timeout = {.tv_sec = timeout_sec, .tv_usec = timeout_usec};

  int ret =
      setsockopt(sock, SOL_SOCKET, SO_RCVTIMEO, &timeout, sizeof(timeout));
  if (ret < 0) {
    LOG_ERR("Failed to set socket timeout: %d", errno);
    return -errno;
  }

  LOG_INF("Socket timeout configured: %d seconds, %d microseconds", timeout_sec,
          timeout_usec);
  return 0;
}

static int resolve_server(void) {
  int ret;
  struct addrinfo *result;
  struct addrinfo hints = {.ai_family = AF_INET, .ai_socktype = SOCK_DGRAM};

  ret = getaddrinfo(CONFIG_COAP_SERVER_HOSTNAME, NULL, &hints, &result);
  if (ret != 0) {
    LOG_ERR("Failed to resolve server address: %d", ret);
    return -EIO;
  }

  if (!result) {
    LOG_ERR("No address found for server");
    return -ENOENT;
  }

  struct sockaddr_in *server4 = (struct sockaddr_in *)&server;
  server4->sin_addr.s_addr =
      ((struct sockaddr_in *)result->ai_addr)->sin_addr.s_addr;
  server4->sin_family = AF_INET;
  server4->sin_port = htons(CONFIG_COAP_SERVER_PORT);

  char ipv4_addr[NET_IPV4_ADDR_LEN];
  inet_ntop(AF_INET, &server4->sin_addr.s_addr, ipv4_addr, sizeof(ipv4_addr));
  LOG_INF("Resolved IPv4 Address: %s", ipv4_addr);

  freeaddrinfo(result);
  return 0;
}

static int connect_to_server(void) {
  sock = socket(AF_INET, SOCK_DGRAM, IPPROTO_UDP);
  if (sock < 0) {
    LOG_ERR("Failed to create socket: %d", errno);
    return -errno;
  }

  if (connect(sock, (struct sockaddr *)&server, sizeof(struct sockaddr_in)) <
      0) {
    LOG_ERR("Failed to connect to server: %d", errno);
    return -errno;
  }

  LOG_INF("Connected to server");
  next_token = sys_rand32_get();
  return 0;
}

static int prepare_coap_request(struct coap_packet *request, uint8_t method,
                                const char *path, const uint8_t *payload,
                                size_t payload_len) {
  int ret = coap_packet_init(
      request, coap_buf, sizeof(coap_buf), APP_COAP_VERSION, COAP_TYPE_NON_CON,
      sizeof(next_token), (uint8_t *)&next_token, method, coap_next_id());
  if (ret < 0) {
    LOG_ERR("Failed to initialize CoAP packet: %d", ret);
    return ret;
  }

  ret = coap_packet_set_path(request, path);
  if (ret < 0) {
    LOG_ERR("Failed to set URI path: %d", ret);
    return ret;
  }

  if (payload && payload_len > 0) {
    ret =
        coap_packet_append_option(request, COAP_OPTION_CONTENT_FORMAT,
                                  &(uint8_t){COAP_CONTENT_FORMAT_APP_JSON}, 1);
    if (ret < 0) {
      LOG_ERR("Failed to set content format: %d", ret);
      return ret;
    }

    ret = coap_packet_append_payload_marker(request);
    if (ret < 0) {
      LOG_ERR("Failed to append payload marker: %d", ret);
      return ret;
    }

    ret = coap_packet_append_payload(request, payload, payload_len);
    if (ret < 0) {
      LOG_ERR("Failed to append payload: %d", ret);
      return ret;
    }
  }

  return 0;
}

static int handle_response(uint8_t *buf, int received) {
  struct coap_packet reply;
  uint8_t token[8];
  uint16_t token_len;
  const uint8_t *payload;
  uint16_t payload_len;

  int ret = coap_packet_parse(&reply, buf, received, NULL, 0);
  if (ret < 0) {
    LOG_ERR("Malformed response received: %d", ret);
    return ret;
  }

  token_len = coap_header_get_token(&reply, token);
  if (token_len != sizeof(next_token) ||
      memcmp(&next_token, token, sizeof(next_token)) != 0) {
    LOG_ERR("Invalid token received");
    return -EINVAL;
  }

  payload = coap_packet_get_payload(&reply, &payload_len);
  if (payload_len > 0) {
    LOG_INF("CoAP response payload: %.*s", payload_len, (const char *)payload);
  } else {
    LOG_INF("CoAP response payload: EMPTY");
  }

  return 0;
}

static int send_coap_request_and_wait(uint8_t method, const char *path,
                                      const uint8_t *payload,
                                      size_t payload_len) {
  struct coap_packet request;
  int ret, received;

  next_token = sys_rand32_get();
  ret = prepare_coap_request(&request, method, path, payload, payload_len);
  if (ret < 0) {
    return ret;
  }

  ret = send(sock, request.data, request.offset, 0);
  if (ret < 0) {
    LOG_ERR("Failed to send CoAP request: %d", errno);
    return -errno;
  }

  LOG_INF("CoAP request sent: Token 0x%04x", next_token);

  received = recv(sock, coap_buf, sizeof(coap_buf), 0);
  if (received < 0) {
    if (errno == EAGAIN || errno == EWOULDBLOCK) {
      LOG_ERR("Receive timeout occurred");
      return -ETIMEDOUT;
    } else {
      LOG_ERR("Failed to receive CoAP response: %d", errno);
      return -errno;
    }
  } else if (received == 0) {
    LOG_INF("Empty datagram received");
    return 0;
  }

  ret = handle_response(coap_buf, received);
  if (ret < 0) {
    LOG_ERR("Failed to handle response: %d", ret);
  }

  return ret;
}

int coap_client_send_env_data(int temperature, int humidity) {
  char telemetry_payload[128];

  snprintf(telemetry_payload, sizeof(telemetry_payload),
           "{\"temperature\": %d, \"humidity\": %d}", temperature, humidity);

  int ret = send_coap_request_and_wait(COAP_METHOD_POST, COAP_PATH,
                                       (uint8_t *)telemetry_payload,
                                       strlen(telemetry_payload));
  if (ret < 0) {
    LOG_ERR("POST request failed: %d", ret);
    return ret;
  }
  return 0;
}

int coap_client_init(void) {
  int ret;

  ret = resolve_server();
  if (ret != 0) {
    return ret;
  }

  ret = connect_to_server();
  if (ret != 0) {
    return ret;
  }

  ret = configure_socket_timeout(sock, 5, 0);
  if (ret != 0) {
    return ret;
  }

  LOG_INF("CoAP client initialized");
  return 0;
}
```

## src/coap_client.h
```c
/*
 * Copyright (c) 2024 Tareq Mhisen
 *
 * SPDX-License-Identifier: Apache-2.0
 */

#ifndef APP_COAP_CLIENT_H_
#define APP_COAP_CLIENT_H_

int coap_client_init(void);
int coap_client_send_env_data(int temperature, int humidity);

#endif /* APP_COAP_CLIENT_H_ */
```

## src/modem_svc.c
```c
/*
 * Copyright (c) 2024 Tareq Mhisen
 * Copyright (c) 2020 Nordic Semiconductor ASA
 *
 * SPDX-License-Identifier: Apache-2.0
 * SPDX-License-Identifier: LicenseRef-Nordic-5-Clause
 */

#include <zephyr/kernel.h>
#include <zephyr/logging/log.h>

#include <modem/lte_lc.h>
#include <modem/nrf_modem_lib.h>

#include "modem_svc.h"

LOG_MODULE_REGISTER(modem_svc, LOG_LEVEL_INF);

/* Semaphore used to block the main thread until modem has established an LTE
 * connection.
 */
static K_SEM_DEFINE(lte_connected, 0, 1);

static void lte_handler(const struct lte_lc_evt *const evt) {
  switch (evt->type) {
  case LTE_LC_EVT_NW_REG_STATUS:
    if ((evt->nw_reg_status != LTE_LC_NW_REG_REGISTERED_HOME) &&
        (evt->nw_reg_status != LTE_LC_NW_REG_REGISTERED_ROAMING)) {
      break;
    }
    LOG_INF("Network registration status: %s",
            evt->nw_reg_status == LTE_LC_NW_REG_REGISTERED_HOME
                ? "Connected - home network"
                : "Connected - roaming");
    k_sem_give(&lte_connected);
    break;

  case LTE_LC_EVT_RRC_UPDATE:
    LOG_INF("RRC mode: %s",
            evt->rrc_mode == LTE_LC_RRC_MODE_CONNECTED ? "Connected" : "Idle");
    break;

  case LTE_LC_EVT_PSM_UPDATE:
    LOG_INF("PSM update: TAU interval: %d sec, Active time: %d sec",
            evt->psm_cfg.tau, evt->psm_cfg.active_time);
    break;

  case LTE_LC_EVT_MODEM_SLEEP_ENTER:
    LOG_INF("Modem has entered sleep mode!");
    break;

  case LTE_LC_EVT_MODEM_SLEEP_EXIT:
    LOG_INF("Modem has exited sleep mode!");
    break;

  default:
    break;
  }
}

int modem_svc_init(void) {
  int ret;

  ret = nrf_modem_lib_init();
  if (ret != 0) {
    LOG_ERR("Failed to initialize the modem library: %d", ret);
    return ret;
  }

  ret = lte_lc_connect_async(lte_handler);
  if (ret != 0) {
    LOG_ERR("Failed to connect to LTE network: %d", ret);
    return ret;
  }

  k_sem_take(&lte_connected, K_FOREVER);
  LOG_INF("Connected to LTE network");

  return 0;
}
```

## src/modem_svc.h
```c
/*
 * Copyright (c) 2024 Tareq Mhisen
 *
 * SPDX-License-Identifier: Apache-2.0
 */

#ifndef APP_MODEM_SVC_H_
#define APP_MODEM_SVC_H_

int modem_svc_init(void);

#endif /* APP_MODEM_SVC_H_ */
```
